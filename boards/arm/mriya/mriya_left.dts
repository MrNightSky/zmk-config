/*
 * Copyright (c) 2023 Anderi Gaevskii
 *
 * SPDX-License-Identifier: MIT
 */

#include "mriya.dtsi"


/ {
    /* Включаем USB-CDC для студии */
    zephyr_udc0: &usbd {
        dr_mode = "peripheral";
        status  = "okay";
    };

    /* Привязываем консоль Zephyr к UART0 */
    chosen {
        zephyr,console    = &uart0;
        zephyr,shell-uart = &uart0;
    };
};

&kscan0 {
	col-gpios
		= <&gpio0 22 GPIO_ACTIVE_HIGH>
		, <&gpio1  0 GPIO_ACTIVE_HIGH>
		, <&gpio1  3 GPIO_ACTIVE_HIGH>
		, <&gpio1  1 GPIO_ACTIVE_HIGH>
		, <&gpio1  2 GPIO_ACTIVE_HIGH>
		, <&gpio1  4 GPIO_ACTIVE_HIGH>;
};
