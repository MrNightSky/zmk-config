## boards/arm/mriya44/Kconfig.board
```kconfig
config BOARD_MRIYA44_LEFT
    bool "mriya44 left"
    depends on SOC_NRF52840_QIAA

config BOARD_MRIYA44_RIGHT
    bool "mriya44 right"
    depends on SOC_NRF52840_QIAA
```
